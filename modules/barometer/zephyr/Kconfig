## modules/barometer/zephyr/Kconfig
```kconfig
# SPDX-License-Identifier: Apache-2.0

config ASR_BAROMETER
	bool "ASR HP206F barometer helper"
	default n
	depends on SENSOR && HP206C
	help
	  Project wrapper for the HP206F pressure and temperature channels using
	  Zephyr's command-compatible HP206C sensor driver.

config ASR_BAROMETER_THREAD
	bool "ASR barometer background thread"
	default n
	depends on ASR_BAROMETER
	help
	  Periodically samples pressure and temperature in a dedicated low-priority
	  thread and emits rate-limited log output.

config ASR_BAROMETER_OSR
	int "Barometer oversampling rate"
	default 1024
	range 128 4096
	depends on ASR_BAROMETER
	help
	  Valid HP206F values are 128, 256, 512, 1024, 2048 and 4096.

config ASR_BAROMETER_STARTUP_DELAY_MS
	int "Barometer startup delay in milliseconds"
	default 300
	range 0 60000
	depends on ASR_BAROMETER_THREAD

config ASR_BAROMETER_PERIOD_MS
	int "Barometer sampling period in milliseconds"
	default 500
	range 1 60000
	depends on ASR_BAROMETER_THREAD

config ASR_BAROMETER_LOG_INTERVAL_MS
	int "Barometer log interval in milliseconds"
	default 5000
	range 1 600000
	depends on ASR_BAROMETER_THREAD

config ASR_BAROMETER_THREAD_STACK_SIZE
	int "Barometer thread stack size"
	default 1536
	range 1024 8192
	depends on ASR_BAROMETER_THREAD

config ASR_BAROMETER_THREAD_PRIORITY
	int "Barometer thread priority"
	default 11
	range 0 15
	depends on ASR_BAROMETER_THREAD
	help
	  Preemptive Zephyr thread priority; larger values have lower priority.
```

## modules/comm/test/testcase.yaml
```yaml
tests:
  asr_comm.protocol_core:
    platform_allow: qemu_cortex_m3
    integration_platforms:
      - qemu_cortex_m3
    tags: asr_comm protocol_core
```

## modules/comm/zephyr/Kconfig
```kconfig
# SPDX-License-Identifier: Apache-2.0

config ASR_PROTOCOL_CORE
	bool "ASR SDM protocol core"
	default n
	help
	  Transport-independent 8-byte protocol message processing core.
	  Selected automatically by the transport module.  Can be enabled
	  standalone for testing.

# --- Transport selection (mutually exclusive: UART0 has one owner) ----------

choice ASR_PROTOCOL_TRANSPORT
	prompt "ASR protocol transport"
	default ASR_TRANSPORT_UART_AA55
	help
	  Select the transport layer for the ASR SDM protocol.  Only one
	  transport can be enabled because UART0 must have a single owner.

config ASR_TRANSPORT_UART_AA55
	bool "Legacy UART-AA55 transport"
	select ASR_PROTOCOL_CORE
	help
	  Legacy UART [0xAA 0x55 LEN DATA... CHECKSUM] framing on UART0.
	  Uses interrupt-driven RX and poll-based TX.

config ASR_TRANSPORT_BCAN_PROTOL
	bool "BCAN-S01 PROTOL CAN transport"
	select ASR_PROTOCOL_CORE
	help
	  BCAN-S01 13-byte PROTOL frames on UART0.  Decodes CAN frames
	  from the serial stream and forwards 8-byte payloads to the
	  protocol core.  Uses poll-based UART I/O.

endchoice

# --- Legacy backward-compat alias ------------------------------------------

config ASR_COMM
	bool "ASR UART AA55 communication module (legacy)"
	default n
	depends on SERIAL && UART_INTERRUPT_DRIVEN
	help
	  Legacy name for the UART-AA55 transport.  No longer selects the
	  transport directly; use ASR_TRANSPORT_UART_AA55 instead.

if ASR_TRANSPORT_UART_AA55

config ASR_COMM_THREAD_STACK_SIZE
	int "Communication thread stack size"
	default 1024
	depends on ASR_TRANSPORT_UART_AA55
	help
	  Stack size for the UART communication processing thread.

config ASR_COMM_THREAD_PRIORITY
	int "Communication thread priority"
	default 5
	depends on ASR_TRANSPORT_UART_AA55
	help
	  Cooperative priority of the UART communication thread.  Lower
	  numbers mean higher priority.

config ASR_COMM_RX_QUEUE_DEPTH
	int "RX message queue depth"
	default 8
	depends on ASR_TRANSPORT_UART_AA55
	help
	  Maximum number of received frames that can be queued between the
	  ISR and the processing thread before the oldest frame is silently
	  dropped.

endif # ASR_TRANSPORT_UART_AA55 || ASR_COMM

# --- BCAN / CAN transport configuration -------------------------------------

if ASR_TRANSPORT_BCAN_PROTOL

config ASR_CAN_PROTOCOL_REQUEST_CAN_ID
	hex "CAN request identifier"
	default 0x201
	range 0x000 0x7FF
	help
	  Standard CAN ID that this node responds to.  Frames with a
	  different ID are silently ignored.

config ASR_CAN_PROTOCOL_RESPONSE_CAN_ID
	hex "CAN response identifier"
	default 0x281
	range 0x000 0x7FF
	help
	  Standard CAN ID used for response frames.

config ASR_BCAN_PROTOL_RX_QUEUE_DEPTH
	int "Decoded CAN frame queue depth"
	default 8
	range 1 64
	help
	  Maximum number of decoded CAN frames that can be queued between
	  the UART poll loop and the processing thread before the oldest
	  frame is silently dropped.

config ASR_BCAN_INTERBYTE_TIMEOUT_MS
	int "BCAN PROTOL inter-byte timeout (ms)"
	default 20
	range 1 1000
	help
	  Maximum time to wait between bytes of a 13-byte PROTOL frame
	  before giving up and resyncing.

config ASR_CAN_PROTOCOL_THREAD_STACK_SIZE
	int "CAN protocol thread stack size"
	default 2048
	range 512 8192
	help
	  Stack size for the background CAN protocol processing thread.

config ASR_CAN_PROTOCOL_THREAD_PRIORITY
	int "CAN protocol thread priority"
	default 5
	range 0 15
	help
	  Priority for the background CAN protocol processing thread.

endif # ASR_TRANSPORT_BCAN_PROTOL
```

## modules/dynamixel/zephyr/Kconfig
```kconfig
# SPDX-License-Identifier: Apache-2.0

config ASR_DYNAMIXEL
	bool "ASR single-servo Dynamixel RS-485 driver"
	default n
	depends on SERIAL && GPIO
	help
	  Driver helpers for a single XM430-class Dynamixel servo connected over
	  an external RS-485 transceiver with manual direction control for
	  half-duplex Protocol 2.0 transactions.

config ASR_DYNAMIXEL_THREAD
	bool "ASR Dynamixel background bring-up thread"
	default n
	depends on ASR_DYNAMIXEL
	help
	  Spawns a low-priority thread that performs the Dynamixel bring-up
	  sequence (ping, mode/limits configuration, current-position readback)
	  asynchronously without blocking main().

config ASR_DYNAMIXEL_THREAD_STACK_SIZE
	int "Dynamixel thread stack size"
	default 2048
	depends on ASR_DYNAMIXEL_THREAD
	help
	  Stack size for the Dynamixel background bring-up thread.

config ASR_DYNAMIXEL_THREAD_PRIORITY
	int "Dynamixel thread priority"
	default 7
	depends on ASR_DYNAMIXEL_THREAD
	help
	  Cooperative priority for the Dynamixel background thread.

config ASR_DYNAMIXEL_STARTUP_DELAY_MS
	int "Dynamixel bring-up startup delay in milliseconds"
	default 0
	depends on ASR_DYNAMIXEL_THREAD
	help
	  Delay before the Dynamixel thread starts the servo bring-up. Useful
	  to give USB/comm peripherals time to settle before the first ping.
```

## modules/imu/zephyr/Kconfig
```kconfig
# SPDX-License-Identifier: Apache-2.0

config ASR_IMU
	bool "ASR IMU driver"
	default y
	depends on SENSOR
	help
	  Driver helpers for the project's IMU sensor. Provides device readiness
	  validation and single-sample reads.

config ASR_AHRS
	bool "ASR AHRS fusion"
	default y
	depends on ASR_IMU
	help
	  AHRS fusion helpers built on top of the IMU sample cache.

config ASR_IMU_THREAD
	bool "IMU read/print background thread"
	default n
	depends on ASR_IMU
	help
	  Spawns a background thread that periodically reads and logs IMU samples.
	  Thread timing is configured with the options below.

config ASR_IMU_STARTUP_DELAY_MS
	int "IMU thread startup delay in milliseconds"
	default 500
	depends on ASR_IMU_THREAD
	help
	  Delay before validating the IMU device and creating the IMU logging
	  thread.

config ASR_IMU_PERIOD_MS
	int "IMU sampling period in milliseconds"
	default 1000
	depends on ASR_IMU_THREAD
	help
	  Delay between IMU fetch and AHRS update iterations. Logging is throttled
	  independently.

config ASR_IMU_LOG_INTERVAL_MS
	int "IMU log interval in milliseconds"
	default 1000
	depends on ASR_IMU
	help
	  Minimum delay between IMU sample log output lines. This only affects
	  serial logging; sampling and AHRS update timing use ASR_IMU_PERIOD_MS.
```
