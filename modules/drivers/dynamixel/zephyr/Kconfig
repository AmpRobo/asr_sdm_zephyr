## modules/drivers/dynamixel/zephyr/Kconfig
```kconfig
# SPDX-License-Identifier: Apache-2.0

config ASR_DYNAMIXEL
	bool "ASR single-servo Dynamixel RS-485 driver"
	default n
	depends on SERIAL && GPIO
	help
	  Driver helpers for a single XM430-class Dynamixel servo connected over
	  an external RS-485 transceiver with manual direction control for
	  half-duplex Protocol 2.0 transactions.
```

## modules/dynamixel/zephyr/dts/bindings/serial/asr,dynamixel-rs485.yaml
```yaml
# SPDX-License-Identifier: Apache-2.0

description: ASR single-servo Dynamixel RS-485 device

compatible: "asr,dynamixel-rs485"

include: uart-device.yaml

properties:
  dir-gpios:
    type: phandle-array
    required: true
    description: >
      Driver direction pin for the external RS-485 transceiver. The pin is
      asserted before sending a packet and deasserted before waiting for the
      servo status packet.

  servo-id:
    type: int
    required: true
    description: Dynamixel ID of the attached servo.

  reply-timeout-us:
    type: int
    default: 20000
    description: Maximum time to wait for a status packet after a transaction.

  turnaround-delay-us:
    type: int
    default: 200
    description: >
      Additional delay after the last transmitted byte before switching the
      RS-485 transceiver back to receive mode.
```

## modules/led/dts/bindings/led/asr,gpio-led-group.yaml
```yaml
# SPDX-License-Identifier: Apache-2.0
description: |
  A logical group of GPIO-driven LEDs. Each entry in gpios is one LED in order
  from index 0..N-1. Active level follows the GPIO flag (GPIO_ACTIVE_HIGH / LOW).

compatible: "asr,gpio-led-group"

include: base.yaml

properties:
  gpios:
    type: phandle-array
    required: true
    description: |
      One GPIO specifier per LED, in stable order (index 0 is the first cell).
```

## modules/led/zephyr/Kconfig
```kconfig
# SPDX-License-Identifier: Apache-2.0

config ASR_LED
	bool "ASR GPIO LED group library"
	default y
	depends on GPIO
	help
	  Library for driving a group of GPIO-connected LEDs described in devicetree
	  (compatible: asr,gpio-led-group). Intended for boards such as Seeed XIAO RP2350.
```
